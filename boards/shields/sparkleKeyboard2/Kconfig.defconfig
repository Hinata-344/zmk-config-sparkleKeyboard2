## boards/shields/sparkleKeyboard2/Kconfig.defconfig
```kconfig
    if SHIELD_SPARKLEKEYBOARD2_LEFT
    
    config ZMK_KEYBOARD_NAME
    	default "sk_l"
    
    config ZMK_SPLIT_BLE_ROLE_CENTRAL
    	default y
    
    endif
    
    if SHIELD_SPARKLEKEYBOARD2_RIGHT
    
    config ZMK_KEYBOARD_NAME
    	default "sk_r"
    	
    endif
    
    if SHIELD_SPARKLEKEYBOARD2_LEFT || SHIELD_SPARKLEKEYBOARD2_RIGHT
    
    config ZMK_SPLIT
    	default y
    
    endif
```

## boards/shields/sparkleKeyboard2/Kconfig.shield
```kconfig
    # Copyright (c) 2020 Pete Johanson
    # SPDX-License-Identifier: MIT
    
    config SHIELD_SPARKLEKEYBOARD2_LEFT
    	def_bool $(shields_list_contains,sparkleKeyboard2_left)
    
    config SHIELD_SPARKLEKEYBOARD2_RIGHT
    	def_bool $(shields_list_contains,sparkleKeyboard2_right)
```
